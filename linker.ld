ENTRY(_start)

/* Multiboot header должен быть в первых 32KB загруженного образа */
SECTIONS
{
    . = 1M;

    /* .text секция содержит Multiboot header в начале */
    /* Заголовок должен быть в первых 32KB загруженного образа */
    .text : {
        *(.text)
    }

    /* Только для чтения данные */
    .rodata : {
        *(.rodata)
    }

    /* Данные */
    .data : {
        *(.data)
    }

    /* BSS */
    .bss : {
        *(COMMON)
        *(.bss)
    }
}

/* Убеждаемся, что заголовок в первых 32KB загруженного образа */
/* Program header должен начинаться с 1MB, где находится заголовок */

